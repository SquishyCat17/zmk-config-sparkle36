## boards/shields/sparkle36/Kconfig.defconfig
```kconfig
if SHIELD_SPARKLE36_LEFT

config ZMK_KEYBOARD_NAME
    default "sparkle36"

config ZMK_SPLIT_ROLE_CENTRAL
    default y

endif # SHIELD_SPARKLE36_LEFT

if SHIELD_SPARKLE36_LEFT || SHIELD_SPARKLE36_RIGHT

config ZMK_SPLIT
    default y

endif # SHIELD_SPARKLE36_LEFT || SHIELD_SPARKLE36_RIGHT
```

## boards/shields/sparkle36/Kconfig.shield
```kconfig
config SHIELD_SPARKLE36_LEFT
    def_bool $(shields_list_contains,sparkle36_left)

config SHIELD_SPARKLE36_RIGHT
    def_bool $(shields_list_contains,sparkle36_right)
```
